/dts-v1/;
/plugin/;
/ {
	fragment@0 {
		target = <&amba>;
		__overlay__ {
			fabric@a0000000 {
				#address-cells = <2>;
				#size-cells = <2>;
				compatible = "generic-uio";
				reg = <0x0 0xa0000000 0x0 0x1000000>;
				interrupt-parent = <&gic>;
				interrupts = <0 89 4>;
			};
		};
	};
};
